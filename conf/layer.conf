## conf/layer.conf
```bitbake
# We have a conf and classes directory, add to BBPATH
BBPATH .= ":${LAYERDIR}"

# We have recipes-* directories, add to BBFILES
BBFILES += "${LAYERDIR}/recipes-*/*/*.bb \
	${LAYERDIR}/recipes-*/*/*.bbappend"

BBFILE_COLLECTIONS += "raspb-helloblinky"
BBFILE_PATTERN_raspb-helloblinky = "^${LAYERDIR}/"
BBFILE_PRIORITY_raspb-helloblinky = "6"

LAYERDEPENDS_raspb_helloblinky = "raspberrypi"
LAYERVERSION_raspb_helloblinky = "1"
```
